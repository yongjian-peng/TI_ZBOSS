/**
 * @cliArgs --board "/ti/boards/LP_EM_CC2340R53" --device "CC2340R53RKP" --part "Default" --package "RKP" --rtos "freertos" --product "simplelink_lowpower_f3_sdk@9.10.00.83"
 * @versions {"tool":"1.23.1+4034"}
 */

/**
 * Import the modules used in this configuration.
 */
const FreeRTOS = scripting.addModule("/freertos/FreeRTOS");
const CCFG     = scripting.addModule("/ti/devices/CCFG");
const rfdesign = scripting.addModule("/ti/devices/radioconfig/rfdesign");
const GPIO     = scripting.addModule("/ti/drivers/GPIO");
const GPIO1    = GPIO.addInstance();
const GPIO2    = GPIO.addInstance();
const GPIO3    = GPIO.addInstance();
const GPIO4    = GPIO.addInstance();
const UART2    = scripting.addModule("/ti/drivers/UART2", {}, false);
const UART21   = UART2.addInstance();
const Settings = scripting.addModule("/ti/posix/freertos/Settings");
const zigbee   = scripting.addModule("/ti/zigbee/zigbee");

/**
 * Write custom configuration values to the imported modules.
 */
FreeRTOS.heapSize       = 0x00001BBC;
FreeRTOS.idleStackSize  = 0x00000100;
FreeRTOS.timerStackSize = 0x00000100;

CCFG.ccfgTemplate.$name = "ti_devices_CCFG_CCFGCC23X0Template0";

GPIO1.$hardware = system.deviceData.board.components.LED_GREEN;
GPIO1.$name     = "CONFIG_GPIO_GLED";

GPIO2.$hardware = system.deviceData.board.components.LED_RED;
GPIO2.$name     = "CONFIG_GPIO_RLED";

GPIO3.$hardware        = system.deviceData.board.components["BTN-1"];
GPIO3.$name            = "CONFIG_GPIO_BTN1";
GPIO3.pull             = "Pull Up";
GPIO3.interruptTrigger = "Falling Edge";

GPIO4.$hardware        = system.deviceData.board.components["BTN-2"];
GPIO4.$name            = "CONFIG_GPIO_BTN2";
GPIO4.pull             = "Pull Up";
GPIO4.interruptTrigger = "Falling Edge";

UART21.$name     = "CONFIG_UART2_0";
UART21.$hardware = system.deviceData.board.components.XDS110UART;

zigbee.deviceType = ["zr"];

const RNG       = scripting.addModule("/ti/drivers/RNG", {}, false);
RNG.rngPoolSize = 512;
scripting.suppress("This the default noise conditioning key provided by TI, which is acceptable per NIST SP 800-90B\\. However, TI recommends you change this default value to a custom random value for your product", RNG, "noiseConditioningKeyW3");

/**
 * Pinmux solution for unlocked pins/peripherals. This ensures that minor changes to the automatic solver in a future
 * version of the tool will not impact the pinmux you originally saw.  These lines can be completely deleted in order to
 * re-solve from scratch.
 */
GPIO1.gpioPin.$suggestSolution            = "boosterpack.40";
GPIO2.gpioPin.$suggestSolution            = "boosterpack.39";
GPIO3.gpioPin.$suggestSolution            = "boosterpack.13";
GPIO4.gpioPin.$suggestSolution            = "boosterpack.12";
UART21.uart.$suggestSolution              = "UART0";
UART21.uart.dmaTxChannel.$suggestSolution = "DMA_CH1";
UART21.uart.dmaRxChannel.$suggestSolution = "DMA_CH0";
UART21.uart.txPin.$suggestSolution        = "boosterpack.4";
UART21.uart.rxPin.$suggestSolution        = "boosterpack.3";
